## zmk-config/west.yml
```yaml
manifest:
  remotes:
    - name: zmkfirmware
      url-base: https://github.com/zmkfirmware
    - name: MuneebBaderoen
      url-base: https://github.com/MuneebBaderoen
    - name: urob
      url-base: https://github.com/urob
    - name: badjeff
      url-base: https://github.com/badjeff
  projects:
    - name: zmk
      remote: zmkfirmware
      revision: v0.3
      clone-depth: 1
      import: app/west.yml
    - name: zmk-helpers
      remote: urob
      revision: v0.3 # Should match ZMK release.
    - name: zmk-tri-state
      remote: MuneebBaderoen
      revision: main
      clone-depth: 1
    - name: zmk-magic-key
      remote: MuneebBaderoen
      revision: main
      clone-depth: 1
    - name: zmk-output-behavior-listener
      remote: badjeff
      revision: 92415c775ecf074c4d4463949c3d85560c54c51d
      clone-depth: 1
  self:
    path: .
```

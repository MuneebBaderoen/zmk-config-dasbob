## config/boards/shields/dasbob/Kconfig.defconfig
```kconfig
# Copyright (c) 2021 The ZMK Contributors
# SPDX-License-Identifier: MIT

# Keyboard name
config ZMK_KEYBOARD_NAME
	default "Muneeb's Dasbob"

# Always enable split
config ZMK_SPLIT
	bool
	default y

# Central role
config ZMK_SPLIT_ROLE_CENTRAL
	bool
	default y if SHIELD_DASBOB_LEFT || SHIELD_DASBOB_DONGLE

# Peripheral role
config ZMK_SPLIT_ROLE_PERIPHERAL
	bool
	default y if SHIELD_DASBOB_RIGHT || SHIELD_DASBOB_LEFT_PERIPHERAL || SHIELD_DASBOB_RIGHT_PERIPHERAL
    default n if SHIELD_DASBOB_DONGLE

# Dongle-specific
config ZMK_SPLIT_BLE_CENTRAL_PERIPHERALS
	int	
	default 2 if SHIELD_DASBOB_DONGLE

config ZMK_USB_ENABLED
    bool
    default y if SHIELD_DASBOB_DONGLE

config ZMK_LOG_ENABLED
    bool
    default y if SHIELD_DASBOB_DONGLE

config ZMK_LOGGING
    bool
    default y if SHIELD_DASBOB_DONGLE

config USB_DEVICE_PRODUCT
    string
    default "Dasbob Dongle" if SHIELD_DASBOB_DONGLE

config ZMK_BLE_ENABLED
	bool
	default y

config ZMK_USB_LOGGING
    bool
    default y if SHIELD_DASBOB_DONGLE

config USB_CDC_ACM
	bool
	default y if SHIELD_DASBOB_DONGLE
```

## config/boards/shields/dasbob/Kconfig.shield
```kconfig
# Copyright (c) 2021 The ZMK Contributors
# SPDX-License-Identifier: MIT

config SHIELD_DASBOB_LEFT
	def_bool $(shields_list_contains,dasbob_left)

config SHIELD_DASBOB_RIGHT
	def_bool $(shields_list_contains,dasbob_right)

config SHIELD_DASBOB_DONGLE
	def_bool $(shields_list_contains,dasbob_dongle)

config SHIELD_DASBOB_LEFT_PERIPHERAL
	def_bool $(shields_list_contains,dasbob_left_peripheral)
	
config SHIELD_DASBOB_RIGHT_PERIPHERAL
	def_bool $(shields_list_contains,dasbob_right_peripheral)
```

## zmk-config/boards/shields/dasbob/Kconfig.defconfig
```kconfig
# Copyright (c) 2021 The ZMK Contributors
# SPDX-License-Identifier: MIT

# Keyboard name
config ZMK_KEYBOARD_NAME
	default "Muneeb's Dasbob"

# Always enable split
config ZMK_SPLIT
	bool
	default y

# Central role
config ZMK_SPLIT_ROLE_CENTRAL
	bool
	default y if SHIELD_DASBOB_MAIN_LEFT || SHIELD_DASBOB_DONGLE_CENTRAL

# Peripheral role
config ZMK_SPLIT_ROLE_PERIPHERAL
	bool
	default y if SHIELD_DASBOB_MAIN_RIGHT || SHIELD_DASBOB_DONGLE_LEFT || SHIELD_DASBOB_DONGLE_RIGHT
    default n if SHIELD_DASBOB_DONGLE_CENTRAL

# Dongle-specific
config ZMK_SPLIT_BLE_CENTRAL_PERIPHERALS
	int	
	default 2 if SHIELD_DASBOB_DONGLE_CENTRAL

config ZMK_USB_ENABLED
    bool
    default y if SHIELD_DASBOB_DONGLE_CENTRAL

config USB_DEVICE_PRODUCT
    string
    default "Dasbob Dongle" if SHIELD_DASBOB_DONGLE_CENTRAL

config ZMK_BLE_ENABLED
	bool
	default y

# Enable deep sleep, but only after long inactivity
config ZMK_SLEEP
    bool
    default n if SHIELD_DASBOB_DONGLE_LEFT || SHIELD_DASBOB_DONGLE_RIGHT

config ZMK_DEEP_SLEEP
    bool
    default n if SHIELD_DASBOB_DONGLE_LEFT || SHIELD_DASBOB_DONGLE_RIGHT

# Timeout before going to suspend (light sleep)
config ZMK_IDLE_SLEEP_TIMEOUT
    int
    default 30000 if SHIELD_DASBOB_DONGLE_LEFT || SHIELD_DASBOB_DONGLE_RIGHT  # 30s

# Timeout before going to deep sleep (from suspend)
config ZMK_DEEP_SLEEP_TIMEOUT
    int
    default 3600000 if SHIELD_DASBOB_DONGLE_LEFT || SHIELD_DASBOB_DONGLE_RIGHT  # 1h
```

## zmk-config/boards/shields/dasbob/Kconfig.shield
```kconfig
# Copyright (c) 2021 The ZMK Contributors
# SPDX-License-Identifier: MIT

config SHIELD_DASBOB_MAIN_LEFT
	def_bool $(shields_list_contains,dasbob_main_left)

config SHIELD_DASBOB_MAIN_RIGHT
	def_bool $(shields_list_contains,dasbob_main_right)

config SHIELD_DASBOB_DONGLE_CENTRAL
	def_bool $(shields_list_contains,dasbob_dongle_central)

config SHIELD_DASBOB_DONGLE_LEFT
	def_bool $(shields_list_contains,dasbob_dongle_left)
	
config SHIELD_DASBOB_DONGLE_RIGHT
	def_bool $(shields_list_contains,dasbob_dongle_right)
```

## zmk-modules/sticky-mod-layer/Kconfig
```kconfig
DT_COMPAT_ZMK_BEHAVIOR_STICKY_MOD_LAYER := zmk,behavior-sticky-mod-layer

config ZMK_BEHAVIOR_STICKY_MOD_LAYER
        bool
        default $(dt_compat_enabled,$(DT_COMPAT_ZMK_BEHAVIOR_STICKY_MOD_LAYER))

config ZMK_BEHAVIOR_STICKY_MOD_LAYER_MAX_HELD
        int "Maximum number of simultaneously active sticky mod layer bindings"
        default 10
        range 1 32
        depends on ZMK_BEHAVIOR_STICKY_MOD_LAYER
```

## zmk-modules/sticky-mod-layer/dts/bindings/behaviors/zmk,behavior-sticky-mod-layer.yaml
```yaml
# SPDX-License-Identifier: MIT

description: Sticky mod with continuation layer behavior

compatible: "zmk,behavior-sticky-mod-layer"

include: two_param.yaml

properties:
  bindings:
    type: phandles
    required: true
  release-after-ms:
    type: int
    required: true
  quick-release:
    type: boolean
  ignore-modifiers:
    type: boolean
```
